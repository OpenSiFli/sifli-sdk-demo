## Dual_Bluetooth_Headset_Walkie-Talkie/project/boards/sf32lb57z-core_n8/Kconfig.board
```kconfig
config ASIC
    bool
    default y

menu "SF32LB57Z Core Board Configuration"

    comment "Pin numbers are PAxx numbers. Change them to match the board schematic."

    config BOARD_57Z_UART_TX_PIN
        int "Console UART1 TX pad (PAxx)"
        default 19

    config BOARD_57Z_UART_RX_PIN
        int "Console UART1 RX pad (PAxx)"
        default 18

    config BOARD_57Z_I2S_MCLK_PIN
        int "I2S1 MCLK pad (PAxx)"
        default 2

    config BOARD_57Z_I2S_SDO_PIN
        int "I2S1 SDO pad (PAxx)"
        default 3

    config BOARD_57Z_I2S_SDI_PIN
        int "I2S1 SDI pad (PAxx)"
        default 4

    config BOARD_57Z_I2S_BCK_PIN
        int "I2S1 BCK pad (PAxx)"
        default 5

    config BOARD_57Z_I2S_LRCK_PIN
        int "I2S1 LRCK pad (PAxx)"
        default 6

    config BOARD_57Z_LED1_PIN
        int "Headset 1 LED pad (PAxx)"
        default 31

    config BOARD_57Z_LED2_PIN
        int "Headset 2 LED pad (PAxx)"
        default 21

    config BOARD_57Z_LED_ACTIVE_LOW
        bool "LEDs are active low"
        default y

endmenu
```

## Dual_Bluetooth_Headset_Walkie-Talkie/project/boards/sf32lb57z-core_n8/hcpu/Kconfig.board
```kconfig
config BSP_USING_BOARD_SF32LB57Z_CORE_N8
    bool
    select SOC_SF32LB57X
    select SOC_SF32LB57ZUN3N6
    select BF0_HCPU
    default y

rsource "../Kconfig.board"
```

## ai_camera/project/Kconfig.proj
```kconfig
menu "XiaoZhi over Bluetooth PAN"

config LEARNING_CAMERA_BT_NAME
    string "Bluetooth device name"
    default "sifli-learning-camera"

config LEARNING_CAMERA_PAN_CONNECT_DELAY_MS
    int "PAN connect delay after pairing (ms)"
    default 3000
    range 1000 10000

config LEARNING_CAMERA_PAN_RETRY_DELAY_MS
    int "PAN reconnect delay (ms)"
    default 10000
    range 1000 60000

config LEARNING_CAMERA_PAN_RETRY_MAX
    int "PAN reconnect attempts"
    default 5
    range 1 20

endmenu

menu "Assistant UI diagnostics"

config LEARNING_CAMERA_UI_LOG
    bool "Camera UI timing and redraw diagnostics"
    default y

config LEARNING_CAMERA_FPS_LOG
    bool "Camera fps diagnostics"
    default y

endmenu

config CUSTOM_MEM_MAP
    bool
    select custom_mem_map
    default y if !SOC_SIMULATOR

source "$SIFLI_PERIPHERALS_ROOT/camera_framework/Kconfig"
```

## camera_57x/acpu/Kconfig.proj
```kconfig
config BF0_HCPU
    bool
    default y

config BF0_ACPU
    bool
    default y

config CUSTOM_MEM_MAP
    bool
    select custom_mem_map
    default y

config PSRAM_CACHE_WB
    bool
    default y
```

## camera_57x/components/camera_software/isp/example/project/Kconfig.proj
```kconfig
config CAMERA_SW_ISP_EXAMPLE_HCPU
    bool
    default y

rsource "../../Kconfig"

config CUSTOM_MEM_MAP
    bool
    select custom_mem_map
    default y
```

## camera_57x/project/Kconfig.proj
```kconfig
#APP specific configuration.
choice
    prompt "Camera sensor backend"
    default CAMERA_SENSOR_GC032A

config CAMERA_SENSOR_GC032A
    bool "GC032A"
    select BSP_USING_DCMI
    select BSP_USING_PWMT2

config CAMERA_SENSOR_ARDUCAM_OV2640
    bool "Arducam OV2640 SPI FIFO"
    select BSP_USING_I2C
    select BSP_USING_I2C1
    select BSP_USING_SPI
    select BSP_USING_SPI2
    select BSP_SPI2_RX_USING_DMA
    select BSP_SPI2_TX_USING_DMA
endchoice

if CAMERA_SENSOR_ARDUCAM_OV2640

comment "OV2640 direct RGB565 preview is temporarily unavailable"
comment "This demo only supports JPEG over the ArduChip SPI FIFO."
comment "No OV2640 DVP/parallel-camera backend is provided."

endif

rsource "../components/camera_software/Kconfig"

config CUSTOM_MEM_MAP
    bool
	select custom_mem_map
	default y if !SOC_SIMULATOR
```
