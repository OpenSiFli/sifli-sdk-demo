## ai_camera/project/Kconfig.proj
```kconfig
menu "XiaoZhi over Bluetooth PAN"

config LEARNING_CAMERA_BT_NAME
    string "Bluetooth device name"
    default "sifli-learning-camera"

config LEARNING_CAMERA_PAN_CONNECT_DELAY_MS
    int "PAN connect delay after pairing (ms)"
    default 3000
    range 1000 10000

config LEARNING_CAMERA_PAN_RETRY_DELAY_MS
    int "PAN reconnect delay (ms)"
    default 10000
    range 1000 60000

config LEARNING_CAMERA_PAN_RETRY_MAX
    int "PAN reconnect attempts"
    default 5
    range 1 20

endmenu

menu "Assistant UI diagnostics"

config LEARNING_CAMERA_UI_LOG
    bool "Camera UI timing and redraw diagnostics"
    default y

config LEARNING_CAMERA_FPS_LOG
    bool "Camera fps diagnostics"
    default y

endmenu

config CUSTOM_MEM_MAP
    bool
    select custom_mem_map
    default y if !SOC_SIMULATOR

menu "Board camera hardware"

config CAMERA_I2C_DEVICE_NAME
    string "SCCB I2C device name"
    default "i2c1"

config CAMERA_XCLK_ENABLE
    bool "MCU drives the camera MCLK"
    default y

config CAMERA_XCLK_PWM_DEVICE_NAME
    string "PWM device that drives the camera MCLK"
    default "pwmt2"
    depends on CAMERA_XCLK_ENABLE

config CAMERA_XCLK_PWM_CHANNEL
    int "PWM channel that drives the camera MCLK"
    default 1
    depends on CAMERA_XCLK_ENABLE

config CAMERA_DCMI_PCLK_FALLING
    bool "Sample the DVP pixel clock on the falling edge"
    default n

endmenu

# The camera framework Kconfig (CAMERA_FRAMEWORK_ENABLE, sensor/data-bus
# selection) now comes from the libcamera sf-pkg component: the build Kconfig
# gets `osource "<project>/sf-pkgs/Kconfig.conandeps"`, which sources
# sf-pkgs/full_deploy/host/libcamera/<ver>/Kconfig. Do not source it again from
# an out-of-tree checkout.
```

## screen_cast_v3/src/protocol/Kconfig
```kconfig
menu "Screen cast (OTA-V3 continual file stream)"

config USING_SCREEN_CAST
    bool "Enable screen cast service"
    depends on FRAMED_PROTO && PKG_USING_LITTLEVGL2RTT
    default n
    help
        Receive a live screen / map cast pushed by the phone app over the BLE
        serial transmission channel (SiFli OTA-V3 "continual file" stream) and
        expose the decoded JPEG / audio / navigation frames to the application.

        Only the protocol component (FRAMED_PROTO) is needed: the frame layout,
        the response builders and the link are all shared. The firmware-update
        engine (OTA_EXT_V3) is not required.

config USING_SCREEN_CAST_WIFI
    bool "Enable WiFi (P2P GO + TCP) cast transport"
    depends on USING_SCREEN_CAST && RT_USING_WIFI && RT_USING_LWIP
    default n
    help
        Add a TCP transport on top of the screen cast service: the device
        starts a P2P GO hotspot and a TCP server, the phone joins the
        hotspot and connects to the server. The frame format is identical
        to the BT PAN transport used by solution2.0 (see src/wifi_tran).

        Requires a WiFi driver with P2P GO support (e.g. AIC8800D40L).

config USING_SCREEN_CAST_WIFI_AP
    bool "Use plain SoftAP instead of P2P GO"
    depends on USING_SCREEN_CAST_WIFI
    default n
    help
        Start a plain SoftAP (rt_wlan_start_ap) instead of a WiFi Direct
        P2P GO group (rt_wlan_p2p_go_start): the SSID shows up in the normal
        WiFi list, so any phone (including iPhone) can join it directly.
        The trade-off is that the phone drops its current WiFi while
        connected, and the channel is fixed to 6 (use rt_wlan_start_ap_adv()
        to pick a channel).

        Requires a driver with wlan_softap support (e.g. AIC8800D40L).

endmenu
```
